## CMakeLists.txt
```
cmake_minimum_required(VERSION 3.13.1)

set(BOARD_ROOT "${CMAKE_CURRENT_SOURCE_DIR}/../..")
set(DTS_ROOT "${CMAKE_CURRENT_SOURCE_DIR}/../..")
set(BOARD qorvo_dwm3001cdk)

find_package(Zephyr REQUIRED HINTS $ENV{ZEPHYR_BASE})
project(sit_ble_mesh)

# Add source files
target_sources(app PRIVATE src/main.c)

# Add include directories
target_include_directories(app PRIVATE
  ../../include
  ../../lib/sit_mesh
  ../../lib/sit_led
  ../../drivers/platform
)

# Link SIT libraries
target_link_libraries(app PRIVATE
  ${CMAKE_CURRENT_SOURCE_DIR}/../../lib/sit_mesh/libsit_mesh.a
  ${CMAKE_CURRENT_SOURCE_DIR}/../../lib/sit_led/libsit_led.a
)

# Configure build options
target_compile_options(app PRIVATE
  -fdiagnostics-color=always
  -O1
)

# Add debug configurations if needed
if(CONFIG_DEBUG)
    target_compile_options(app PRIVATE
    -g3
    -ggdb
    -fno-omit-frame-pointer
  )
endif()
```

## prj.conf
```kconfig
# Logging
CONFIG_LOG=y
CONFIG_LOG_PRINTK=y

CONFIG_INIT_STACKS=y
CONFIG_MAIN_STACK_SIZE=512
CONFIG_SYSTEM_WORKQUEUE_STACK_SIZE=2048

CONFIG_FLASH=y
CONFIG_FLASH_MAP=y
CONFIG_NVS=y
CONFIG_SETTINGS=y

# Bluetooth configuration
CONFIG_BT=y
CONFIG_BT_PERIPHERAL=y
CONFIG_BT_OBSERVER=y
CONFIG_BT_BROADCASTER=y

# Bluetooth Mesh configuration
CONFIG_BT_MESH=y
CONFIG_BT_MESH_RELAY=y
CONFIG_BT_MESH_RELAY_ENABLED=y
CONFIG_BT_MESH_BEACON_ENABLED=y
CONFIG_BT_MESH_LOW_POWER=y
CONFIG_BT_MESH_FRIEND=n
CONFIG_BT_MESH_LPN_RECV_DELAY=100
CONFIG_BT_MESH_LPN_SCAN_LATENCY=30

# GATT Proxy
CONFIG_BT_MESH_PB_GATT=y
CONFIG_BT_MESH_PB_ADV=y
CONFIG_BT_MESH_GATT_PROXY=y

# Security
CONFIG_BT_SETTINGS=y
CONFIG_BT_MESH_SUBNET_COUNT=2
CONFIG_BT_MESH_APP_KEY_COUNT=2
CONFIG_BT_MESH_MODEL_GROUP_COUNT=2
CONFIG_BT_MESH_LABEL_COUNT=3

# Device name configuration
CONFIG_BT_DEVICE_NAME="SIT-MESH"
CONFIG_BT_DEVICE_NAME_DYNAMIC=y
CONFIG_BT_DEVICE_NAME_MAX=65

# Debug options (optional)
CONFIG_BT_DEBUG_LOG=n
CONFIG_BT_MESH_DEBUG=n
CONFIG_BT_MESH_DEBUG_NET=n
CONFIG_BT_MESH_DEBUG_TRANS=n
CONFIG_BT_MESH_DEBUG_BEACON=n
CONFIG_BT_MESH_DEBUG_CRYPTO=n
CONFIG_BT_MESH_DEBUG_PROV=n
CONFIG_BT_MESH_DEBUG_ACCESS=n
CONFIG_BT_MESH_DEBUG_MODEL=n
CONFIG_BT_MESH_DEBUG_ADV=n
CONFIG_BT_MESH_DEBUG_LOW_POWER=n
CONFIG_BT_MESH_DEBUG_FRIEND=n
CONFIG_BT_MESH_DEBUG_PROXY=n

# Use newlib
CONFIG_NEWLIB_LIBC=y
CONFIG_NEWLIB_LIBC_FLOAT_PRINTF=y
```

## src/main.c
```c
/**
 * Copyright (c) 2015 - Decawave Ltd, Dublin, Ireland.
 * Copyright (c) 2022 - Sven Hoyer
 * 
 * This is an Simple Bluetooth Low Energy Example for the 
 * DWM1001-DEV Board Zephyr
 */

#include <stddef.h>
#include <string.h>
#include <errno.h>

#include <zephyr/kernel.h>
#include <zephyr/sys/printk.h>
#include <zephyr/sys/byteorder.h>
#include <zephyr/bluetooth/bluetooth.h>

#include <sit_mesh/sit_mesh.h>
#include <sit_led/sit_led.h>

#define APP_NAME "SIMPLE MESH EXAMPLE\n"

/* size of stack area used by each thread */
#define STACKSIZE 2048

int main(void) {
	printk(APP_NAME);
	printk("==================\n");
	k_sleep(K_SECONDS(2));
	sit_mesh_init();
	sit_led_init();

	while(1) {
		if (sit_mesh_is_provisioned()) {
			sit_toggle_led(3);
		} else {
			sit_toggle_led(0);
		}
		k_sleep(K_SECONDS(1));
	}
	return 0;
}
```
