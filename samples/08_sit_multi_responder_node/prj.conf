## CMakeLists.txt
```
# SPDX-License-Identifier: Apache-2.0
cmake_minimum_required(VERSION 3.13.1)

set(BOARD_ROOT "${CMAKE_CURRENT_SOURCE_DIR}/../..")
set(DTS_ROOT "${CMAKE_CURRENT_SOURCE_DIR}/../..")
set(BOARD qorvo_dwm3001cdk)

find_package(Zephyr REQUIRED HINTS $ENV{ZEPHYR_BASE})
project(sit_multi_responder_node)

# the binary only library from Qorvo has problems with -Os or -O2
zephyr_library_compile_options(-O1)

target_sources(app PRIVATE
  src/main.c
)

target_include_directories(app PRIVATE ../../drivers/platform)
```

## sample.yaml
```
sample:
  name: Multi-Responder DS-TWR Node
  description: >
    Configurable Double-Sided Two-Way Ranging responder node that works with
    the multi-responder initiator. Each node can be configured with a unique
    ID and provides high-accuracy distance measurements.

tests:
  sample.uwb.multi_responder_node:
    platform_allow: qorvo_dwm3001cdk
    tags: uwb ds-twr ranging responder node
    harness: console
    harness_config:
      type: multi_line
      regex:
        - "Starting MULTI-RESPONDER DS-TWR Node"
        - "SIT initialization successful"
        - "Responder node .* ready and listening"
```

## prj.conf
```kconfig
# Activate SIT Subsys
CONFIG_SIT=y

# Minimal logging
CONFIG_LOG=y
CONFIG_LOG_MODE_MINIMAL=y
CONFIG_LOG_DEFAULT_LEVEL=0
CONFIG_LOG_OVERRIDE_LEVEL=0
CONFIG_LOG_MAX_LEVEL=0
CONFIG_LOG_PRINTK=n
CONFIG_CBPRINTF_FP_SUPPORT=y

# newlib is used to include extended math.h funcions (e.g. fabs())
CONFIG_NEWLIB_LIBC=y

# Device settings
CONFIG_GPIO=y
CONFIG_SPI=y

# Build optimizations
CONFIG_SIZE_OPTIMIZATIONS=y
```

## src/main.c
```c
#include "deca_device_api.h"

#include <sit/sit.h>
#include <sit/sit_device.h>
#include <sit/sit_distance.h>
#include <sit/sit_config.h>
#include <sit/sit_utils.h>
#include <sit_led/sit_led.h>

#include <zephyr/kernel.h>
#include <zephyr/logging/log.h>

LOG_MODULE_REGISTER(main, LOG_LEVEL_INF);

#define APP_NAME "SIMPLE DS-TWR Responder EXAMPLE (ID configurable from 2-5)\n"

/* Inter-ranging delay period, in milliseconds. */
#define RNG_DELAY_MS 1000

/* Default antenna delay values for 64 MHz PRF. See NOTE 2 below. */
#define TX_ANT_DLY 16385
#define RX_ANT_DLY 16385

/* Default communication configuration. We use default non-STS DW mode. */
static dwt_config_t config = {
    5,                /* Channel number. */
    DWT_PLEN_128,     /* Preamble length. Used in TX only. */
    DWT_PAC8,         /* Preamble acquisition chunk size. Used in RX only. */
    9,                /* TX preamble code. Used in TX only. */
    9,                /* RX preamble code. Used in RX only. */
    DWT_SFD_DW_8,     /* 0 to use standard 8 symbol SFD, 1 to use non-standard 8 symbol, 2 for non-standard 16 symbol SFD and 3 for 4z 8 symbol SDF type */
    DWT_BR_6M8,       /* Data rate. */
    DWT_PHRMODE_STD,  /* PHY header mode. */
    DWT_PHRRATE_STD,  /* PHY header rate. */
    (129 + 8 - 8),    /* SFD timeout (preamble length + 1 + SFD length - PAC size). Used in RX only. */
    DWT_STS_MODE_OFF, /* STS disabled */
    DWT_STS_LEN_64,   /* STS length see allowed values in Enum dwt_sts_lengths_e */
    DWT_PDOA_M0       /* PDOA mode off */
};

uint8_t this_initiator_node_id  = 1;
uint8_t responder_node_id       = 2;  // IMPORTANT: Change to 2, 3, 4, or 5 depending on which responder device this is


#define POLL_RX_TO_RESP_TX_DLY_UUS_T 900
#define RESP_TX_TO_FINAL_RX_DLY_UUS_T 600
#define FINAL_RX_TIMEOUT_T 1200
#define PRE_TIMEOUT 5

int main(void) {
	printk(APP_NAME);
	printk("==================\n");
	printk("Responder ID: %d\n", responder_node_id);

    // INIT LED and let them Blink one Time to see Intitalion Finshed
    sit_led_init();

	int init_ok = 0;
    do {
		init_ok = sit_init();
	} while (init_ok > 1);

    if(init_ok < 0){
        sit_set_led(2, 1);
    } else {
        sit_set_led(1, 1);
    }

    uint8_t frame_sequenz = 0;

	while (1) {
		sit_receive_now(0,0);
        msg_simple_t rx_poll_msg;
		msg_id_t msg_id = twr_1_poll;
		if(sit_check_msg_id(msg_id, &rx_poll_msg)){
            /* Only respond if the message is meant for this responder */
            if(rx_poll_msg.header.dest != responder_node_id) {
                continue;
            }
			uint64_t poll_rx_ts = get_rx_timestamp_u64();

            uint32_t resp_tx_time = (poll_rx_ts + (POLL_RX_TO_RESP_TX_DLY_UUS_T * UUS_TO_DWT_TIME)) >> 8;

            msg_simple_t msg_ds_poll_resp = {
                    ds_twr_2_resp,
                    rx_poll_msg.header.sequence,
                    responder_node_id,  // Always use our configured responder ID
                    rx_poll_msg.header.source,
                    0
                };
            sit_set_rx_after_tx_delay(RESP_TX_TO_FINAL_RX_DLY_UUS_T);
            sit_set_rx_timeout(FINAL_RX_TIMEOUT_T);
            sit_set_preamble_detection_timeout(PRE_TIMEOUT);
            bool ret = sit_send_at_with_response((uint8_t*)&msg_ds_poll_resp, sizeof(msg_simple_t), resp_tx_time);
            if (ret == false) {
                LOG_WRN("Something is wrong with Sending Poll Resp Msg");
                continue;
            }
            msg_ds_twr_final_t rx_ds_final_msg;
		    msg_id = ds_twr_3_final;
            if(sit_check_ds_final_msg_id(msg_id, &rx_ds_final_msg)){
                uint64_t resp_tx_ts = get_tx_timestamp_u64();
                uint64_t final_rx_ts = get_rx_timestamp_u64();

                uint32_t poll_tx_ts = rx_ds_final_msg.poll_tx_ts;
                uint32_t resp_rx_ts = rx_ds_final_msg.resp_rx_ts;
                uint32_t final_tx_ts = rx_ds_final_msg.final_tx_ts;

                uint32_t poll_rx_ts_32, resp_tx_ts_32, final_rx_ts_32;
                poll_rx_ts_32 = (uint32_t) poll_rx_ts;
                resp_tx_ts_32 = (uint32_t) resp_tx_ts;
                final_rx_ts_32 = (uint32_t) final_rx_ts;

                /* No distance calculation here - just send acknowledgment */
                LOG_INF("Responder ID %d - Processed ranging with initiator", responder_node_id);
            } else {
                LOG_WRN("Responder %d - Something is wrong with Final Msg Receive", responder_node_id);
                dwt_writesysstatuslo(SYS_STATUS_ALL_RX_TO | SYS_STATUS_ALL_RX_ERR);
            }

		} else {
			LOG_WRN("Responder %d - Something is wrong with Poll Msg Receive", responder_node_id);
            dwt_writesysstatuslo(SYS_STATUS_ALL_RX_TO | SYS_STATUS_ALL_RX_ERR);
		}
		frame_sequenz++;
        k_msleep(80);
	}

    return 0;
}
```
